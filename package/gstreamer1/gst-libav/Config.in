## package/gstreamer1/gst-libav/Config.in
```kconfig
config BR2_PACKAGE_GST_LIBAV
	bool "gst-libav"
	select BR2_PACKAGE_GST1_PLUGINS_BASE
	depends on BR2_LARGEFILE
	depends on BR2_INET_IPV6
	help
	  GStreamer plugin using Libav.

	  http://gstreamer.freedesktop.org/

comment "gst-libav needs a toolchain w/ largefile, IPv6"
	depends on !(BR2_LARGEFILE && BR2_INET_IPV6)
```

## package/gstreamer1/gst1-rtsp-server/Config.in
```kconfig
config BR2_PACKAGE_GST1_RTSP_SERVER
	bool "gst1-rtsp_server"
	select BR2_PACKAGE_GST1_PLUGINS_BASE
	select BR2_PACKAGE_GST1_PLUGINS_GOOD
	select BR2_PACKAGE_GST1_PLUGINS_GOOD_PLUGIN_UDP
	select BR2_PACKAGE_GST1_PLUGINS_GOOD_PLUGIN_RTP
	select BR2_PACKAGE_GST1_PLUGINS_GOOD_PLUGIN_RTPMANAGER
	help
	  GStreamer plugin .

	  This package contains GStreamer plugins based on
	  the libav project.

	  http://gstreamer.freedesktop.org/
```

## package/libav/Config.in
```kconfig
comment "libav needs a toolchain w/ largefile, IPv6"
	depends on !(BR2_LARGEFILE && BR2_INET_IPV6)

menuconfig BR2_PACKAGE_LIBAV
	bool "libav"
	depends on BR2_LARGEFILE
	depends on BR2_INET_IPV6
	help
	  Libav is a complete, cross-platform solution to record, convert
	  and stream audio and video.

	  http://libav.org

if BR2_PACKAGE_LIBAV

config BR2_PACKAGE_LIBAV_GPL
	bool "Enable GPL code"
	help
	  allow use of GPL code, the resulting libs and binaries will
	  be under GPL

config BR2_PACKAGE_LIBAV_NONFREE
	bool "Enable nonfree code"
	help
	  allow use of nonfree code, the resulting libs and binaries
	  will be unredistributable

config BR2_PACKAGE_LIBAV_AVCONV
	bool "Build avconv (the command line application)"
	select BR2_PACKAGE_LIBAV_SWSCALE
	default y
	help
	  Libav is a very fast video and audio converter.
	  It can also grab from a live audio/video source.

	  It is not needed if you want to link the Libav libraries
	  to your application.

config BR2_PACKAGE_LIBAV_AVPLAY
	bool "Build avplay"
	select BR2_PACKAGE_SDL
	help
	  FFplay is a very simple and portable media player using the
	  Libav libraries and the SDL library.
	  It is mostly used as a testbed for the various Libav APIs.

config BR2_PACKAGE_LIBAV_AVSERVER
	bool "Build avserver"
	help
	  FFserver is a streaming server for both audio and video.

config BR2_PACKAGE_LIBAV_SWSCALE
	bool "Build libswscale"
	help
	  Swscale is a library of video scaling routines.

config BR2_PACKAGE_LIBAV_ENCODERS
	string "Enabled encoders"
	default "all"
	help
	  Space-separated list of encoders to build in Libav,
	  or "all" to build all of them.

	  Run ./configure --list-encoders in the ffmpeg sources
	  directory to know the available options.

config BR2_PACKAGE_LIBAV_DECODERS
	string "Enabled decoders"
	default "all"
	help
	  Space-separated list of decoders to build in Libav,
	  or "all" to build all of them.

	  Run ./configure --list-decoders in the ffmpeg sources
	  directory to know the available options.

config BR2_PACKAGE_LIBAV_MUXERS
	string "Enabled muxers"
	default "all"
	help
	  Space-separated list of muxers to build in Libav,
	  or "all" to build all of them.

	  Run ./configure --list-muxers in the ffmpeg sources
	  directory to know the available options.

config BR2_PACKAGE_LIBAV_DEMUXERS
	string "Enabled demuxers"
	default "all"
	help
	  Space-separated list of demuxers to build in Libav,
	  or "all" to build all of them.

	  Run ./configure --list-demuxers in the ffmpeg sources
	  directory to know the available options.

config BR2_PACKAGE_LIBAV_PARSERS
	string "Enabled parsers"
	default "all"
	help
	  Space-separated list of parsers to build in Libav,
	  or "all" to build all of them.

	  Run ./configure --list-parsers in the ffmpeg sources
	  directory to know the available options.

config BR2_PACKAGE_LIBAV_BSFS
	string "Enabled bitstreams"
	default "all"
	help
	  Space-separated list of bitstream filters to build in Libav,
	  or "all" to build all of them.

	  Run ./configure --list-bsfs in the ffmpeg sources
	  directory to know the available options.

config BR2_PACKAGE_LIBAV_PROTOCOLS
	string "Enabled protocols"
	default "all"
	help
	  Space-separated list of protocols to build in Libav,
	  or "all" to build all of them.

	  Run ./configure --list-protocols in the ffmpeg sources
	  directory to know the available options.

config BR2_PACKAGE_LIBAV_FILTERS
	string "Enabled filters"
	default "all"
	help
	  Space-separated list of filters to build in Libav,
	  or "all" to build all of them.

	  Run ./configure --list-filters in the ffmpeg sources
	  directory to know the available options.

config BR2_PACKAGE_LIBAV_INDEVS
	bool "Enable input devices"
	default y

config BR2_PACKAGE_LIBAV_OUTDEVS
	bool "Enable output devices"
	default y

config BR2_PACKAGE_LIBAV_EXTRACONF
	string "Additional parameters for ./configure"
	default ""
	help
	  Extra parameters that will be appended to Libav's
	  ./configure commandline.

endif
```

## package/python-minimalmodbus/Config.in
```kconfig
config BR2_PACKAGE_PYTHON_MINIMALMODBUS
	bool "python-minimalmodbus"
	depends on (BR2_PACKAGE_PYTHON || BR2_PACKAGE_PYTHON3) && BR2_PACKAGE_PYTHON_SERIAL
	help
	  Easy-to-use Modbus RTU and Modbus ASCII implementation for Python

	  https://pypi.python.org/pypi/MinimalModbus
```

## package/python-twisted/Config.in
```kconfig
config BR2_PACKAGE_PYTHON_TWISTED
	bool "python-twisted"
	depends on (BR2_PACKAGE_PYTHON || BR2_PACKAGE_PYTHON3) && BR2_PACKAGE_PYTHON_ZOPE
	help
	  Twisted is an event-driven networking engine written in Python and licensed under the open source.

	  https://twistedmatrix.com/trac/
```

## package/python-yaml/Config.in
```kconfig
config BR2_PACKAGE_PYTHON_YAML
	bool "python-yaml"
	depends on BR2_PACKAGE_PYTHON || BR2_PACKAGE_PYTHON3
	help
	  PyYAML is a YAML parser and emitter for the Python programming language. 

          http://pyyaml.org/wiki/PyYAML
```

## package/python-zope/Config.in
```kconfig
config BR2_PACKAGE_PYTHON_ZOPE
	bool "python-zope"
	depends on BR2_PACKAGE_PYTHON || BR2_PACKAGE_PYTHON3
	help
		Nothing
```

## package/x264/Config.in
```kconfig
config BR2_PACKAGE_X264
	bool "x264"
	help
	  The x264 encoder libraries for videolan.

	  https://www.videolan.org/developers/x264.html
	
```
